## main/Kconfig.projbuild
```kconfig
menu "Project Configuration"

    orsource "$IDF_PATH/examples/common_components/env_caps/$IDF_TARGET/Kconfig.env_caps"

    config NEOPIXEL_GPIO_PIN
        int "Blink GPIO number"
        range ENV_GPIO_RANGE_MIN ENV_GPIO_OUT_RANGE_MAX
        default 8
        help
            GPIO number (IOxx) to control the LED.
            Some GPIOs are used for other purposes (flash connections, etc.) and cannot be used to blink.

    config PIXEL_COUNT
        int "Number of pixels in the strip"
        range 1 200
        default 8
        help
            The number of leds in the strip.

endmenu
```
